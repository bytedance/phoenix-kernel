## drivers/bytedance/Kconfig
```kconfig
config HW_INFO
	tristate "For vendor hw info"
	default y
	---help---
		This define for vendor hw info
		default Y.
```

## drivers/i2c/aw36429_i2c/Kconfig
```kconfig
#
# AWINIC driver configuration
#

menu "AWINIC I2C driver"

config FLASHLIGHT_AW36429
	tristate "Awinic flashlight with driver IC (AW AW36429)"
	depends on I2C
	default n
	help
		This is for the flashlight driver IC (AW AW36429).
		Say Y here if you want a flashlight driver IC AW36429.
		Select this only if your board has this IC.
		
		Say M here if you want to compile this driver as a module.

#config SUB_CAMERA_FLASH_EN
#	tristate "Awinic sub flashlight with driver IC (AW AW36429)"
#	depends on I2C
#	default n
#	help
#		This is for the flashlight driver IC (AW AW36429).
#
#		Say Y here if you want a flashlight driver IC AW36429.
#		Select this only if your board has this IC.
#
#		Say M here if you want to compile this driver as a module.

endmenu
```

## drivers/misc/aw3750x_driver/Kconfig
```kconfig
config AW3750X_POWER
	tristate "Power Support for AW3750X"
	depends on LEDS_CLASS && I2C
	help
		this option enables support for the aw3750x power connected
		through I2C. Say Y to enable support for the aw3750x
```
